## multimedia/LVGL/guitar_pedals/Kconfig
```kconfig
# Kconfig file for package guitar_pedals
menuconfig PKG_USING_GUITAR_PEDALS
    bool "Enable Guitar Pedals Package"
    default n

if PKG_USING_GUITAR_PEDALS

    config PKG_GUITAR_PEDALS_PATH
        string
        default "/packages/multimedia/LVGL/guitar_pedals"

    config PKG_GUITAR_PEDALS_VER
       string
       default "latest"

endif
```
